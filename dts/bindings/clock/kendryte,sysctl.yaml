## dts/bindings/clock/kendryte,sysctl.yaml
```yaml
#
# SPDX-License-Identifier: Apache-2.0
#
description: This is a representation of the Kendryte Sysctl node

compatible: "kendryte,sysctl"

include: base.yaml

properties:
    compatible:
      type: string-array
      required: true
      description: compatible strings

    reg:
      type: array
      description: mmio register space
      required: true

    label:
      type: string
      required: true
      description: Human readable string describing the device (used by Zephyr for API name)
```

## dts/bindings/dma/kendryte,dma.yaml
```yaml
#
# SPDX-License-Identifier: Apache-2.0
#
description: This is a representation of the Kendryte DMA nodes

compatible: "kendryte,dma"

include: dma-controller.yaml

properties:
    compatible:
      type: string-array
      description: compatible strings

    reg:
      type: array
      description: mmio register space

    label:
      type: string
      description: Human readable string describing the device (used by Zephyr for API name)
```

## dts/bindings/gpio/kendryte,gpiohs.yaml
```yaml
#
# SPDX-License-Identifier: Apache-2.0
#

description: This is a representation of the Kendryte GPIOHS nodes

compatible: "kendryte,gpiohs"

include: [gpio-controller.yaml, base.yaml]

properties:
    compatible:
      type: string-array
      required: true
      description: compatible strings

    reg:
      type: array
      description: mmio register space
      required: true

gpio-cells:
  - pin
  - flags
```

## dts/bindings/pinctrl/kendryte,pinmux.yaml
```yaml
description: This binding gives a base representation of the KENDRYTE PINMUX

compatible: "kendryte,pinmux"

include: base.yaml

properties:
    compatible:
      type: string-array
      required: true
      description: compatible strings

    reg:
      type: array
      description: mmio register space
      required: true

    label:
      type: string
      required: true
      description: Human readable string describing the device (used by Zephyr for API name)
```

## dts/bindings/serial/kendryte,uart.yaml
```yaml
#
# Copyright (c) 2018, SiFive Inc.
#
# SPDX-License-Identifier: Apache-2.0
#
description: >
    This binding gives a base representation of the KENDRYTE UART

compatible: "kendryte,uart"

include: uart-controller.yaml

properties:
    reg:
      type: array
      description: mmio register space
      required: true

    interrupts:
      type: array
      description: required interrupts
      required: true

...
```

## dts/bindings/spi/kendryte,spi.yaml
```yaml
#
# SPDX-License-Identifier: Apache-2.0
#
description: This is a representation of the Kendryte SPI

compatible: "kendryte,spi"

include: spi-controller.yaml

properties:
    compatible:
      type: string-array
      required: true
      description: compatible strings

    reg:
      type: array
      description: mmio register space
      required: true

    label:
      type: string
      required: true
      description: Human readable string describing the device (used by Zephyr for API name)
```

## soc/riscv/riscv-privilege/k210/Kconfig.soc
```kconfig
# Kconfig - RISCV_K210 SOC configuration options
#
# SPDX-License-Identifier: Apache-2.0
#

choice
prompt "K210 SOC implementation"
depends on SOC_SERIES_RISCV_K210

config SOC_RISCV_K210
	bool "K210 SOC implementation"
	select ATOMIC_OPERATIONS_C

endchoice
```
